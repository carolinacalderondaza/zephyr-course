## app/boards/my_copy_board/board.yml
```yaml
board:
  name: my_copy_board
  full_name: MY COPY BOARD
  vendor: iomico
  socs:
    - name: esp32
```

## app/boards/my_scratch_board/Kconfig.my_scratch_board
```kconfig
config HEAP_MEM_POOL_ADD_SIZE_BOARD
	int
	default 4096
	
config BOARD_MY_SCRATCH_BOARD
    	select SOC_ESP32_WROOM_32UE_N4
    	select SOC_ESP32_PROCPU
```

## app/boards/my_scratch_board/board.yml
```yaml
board:
  name: my_scratch_board
  full_name: MY SCRATCH BOARD
  vendor: iomico
  socs:
    - name: esp32
```

## dts/bindings/led,driver.yaml
```yaml
description: Our Simple GPIO driver
compatible: "led,driver"
include: base.yaml

properties:
  gpios:
    type: phandle-array
    required: true
```

## west.yml
```yaml
manifest:
  version: 1.0

  projects:
    - name: zephyr
      url: https://github.com/zephyrproject-rtos/zephyr
      revision: v4.4.0
      import:
        name-allowlist:
          - hal_espressif
          - cmsis_6
          - hal_nxp
          - hal_stm32
          - hal_nordic
          - hal_xtensa
        path-prefix: deps
```
